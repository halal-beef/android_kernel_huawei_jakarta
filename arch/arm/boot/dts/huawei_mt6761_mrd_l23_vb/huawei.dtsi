#include "huawei-led.dtsi"
#include "huawei-tp.dtsi"
#include "huawei-charger.dtsi"
#include "huawei-gnss.dtsi"
#include "huawei-wifi.dtsi"
#include "huawei-lcd.dtsi"
#include "huawei-fingerprint.dtsi"
