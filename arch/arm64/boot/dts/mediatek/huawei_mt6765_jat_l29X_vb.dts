#include <dt-bindings/interrupt-controller/arm-gic.h>
#include <dt-bindings/interrupt-controller/irq.h>
#include <dt-bindings/pinctrl/mt6765-pinfunc.h>
#include <dt-bindings/clock/mt6765-clk.h>
/dts-v1/;
/plugin/;

#include "huawei_common/huawei_common.dtsi"
#include "huawei_mt6765_jat_l29X_vb/huawei.dtsi"
#include "huawei_audio/huawei_mt6735_accdet.dtsi"
#include "huawei_audio/huawei_mt676x_audio_gpio.dtsi"
#include "huawei_audio/cs35l41.dtsi"
#include "huawei_audio/tas2557.dtsi"
#include "huawei_audio/tfa9894.dtsi"

&rootparam {
    mtk,boardid = <4 2 0 7>;
    mtk,board_name = "JAT_L29X_VB";
    mtk,product_name = "JAT-L29";
    hardware_version = "HL1JATMY";
};

&antenna_boardid_detect {
    expect_value = <2034>;
};

#include <k62v1_64_mexico/cust.dtsi>
#include "huawei_mt6765_jat_l29X_vb/huawei-camera.dtsi"
/*End of this file, DO NOT ADD ANYTHING HERE*/

